## zmk-config-caldera/config/boards/shields/caldera/Kconfig.defconfig
```kconfig
if SHIELD_CALDERA_LEFT

config ZMK_KEYBOARD_NAME
    default "Caldera"

config ZMK_SPLIT_ROLE_CENTRAL
    default y

endif

if SHIELD_CALDERA_LEFT || SHIELD_CALDERA_RIGHT

config ZMK_SPLIT
    default y

endif
```

## zmk-config-caldera/config/boards/shields/caldera/Kconfig.shield
```kconfig
config SHIELD_CALDERA_LEFT
    def_bool $(shields_list_contains,caldera_left)

config SHIELD_CALDERA_RIGHT
    def_bool $(shields_list_contains,caldera_right)
```
